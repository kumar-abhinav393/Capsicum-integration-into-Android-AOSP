## capsicum(for-kernel-modification)/Kconfig
```kconfig
config CAPSICUM_SYSCALLS
    bool "Capsicum capability mode syscalls"
    default n
    help
      Enable Capsicum capability mode system calls.
```
